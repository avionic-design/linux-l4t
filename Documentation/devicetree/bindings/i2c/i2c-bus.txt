## Documentation/devicetree/bindings/i2c/i2c-bus.txt
```
I2C busses

I2C busses can be described with a node for the I2C master device
and a set of child nodes for each I2C slave on the bus.

The SPI master node requires the following properties:
- #address-cells  - number of cells required to define a chip select
                    address on the I2C bus.
- #size-cells     - should be zero.
- compatible      - name of I2C bus controller following generic names
                    recommended practice.

Optional property:
- pull-ups-supply : regulator for bus pull ups
```

## Documentation/devicetree/bindings/input/semtech-sx8634.txt
```
Semtech SX8634 Capacitive Button and Slider Touch Controller

The SX8634 touch controller is configured with the following properties:

  Required properties:
  - compatible: "semtech,sx8634-touch"
  - #address-cells: must be <1>
  - #size-cells: must be <0>

  Optional Properties:
  - threshold: number of ticks required to detect a touch/release
    - range: 0x00 to 0xff
    - default: 0xa0
  - sensitivity: sensitivity of the sensors
    - range: 0x0 to 0x7
    - default: 0x0

Each capacitive sensor is configured via a separate sub-node:

  Required Properties:
  - reg: sensor index
  - label: name of the sensor
  - linux,code: Keycode to emit for buttons. If absent, the capacitive sensor
    is part of the slider element.

  Optional Properties:
  - threshold: overrides the global threshold setting
  - sensitivity: overrides the global sensitivity setting

Note: This touch controller node must be a sub node of sx8634 node.

Example:

	keypad: sx8634@2b {
		compatible = "semtech,sx8634";
		reg = <0x2b>;
		interrupts = <386>;

		touch {
			compatible = "semtech,sx8634-touch";
			#address-cells = <1>;
			#size-cells = <0>;

			threshold = <0xa0>;
			sensitivity = <7>;

			cap@1 {
				reg = <1>;
				label = "Up";
				linux,code = <103>; /* KEY_UP */
			};

			cap@2 {
				reg = <2>;
				label = "Down";
				linux,code = <108>; /* KEY_DOWN */
			};
		};
	};
```

## Documentation/devicetree/bindings/media/lm3560.txt
```
TI LM3560 LED flash driver
==========================

Required properties:

- compatible            : "ti,lm3560";
- reg                   : I2C slave address of the driver;

Optional properties:
- max-flash-timeout-ms	  : Maximum timeout for flash
- peak-current		  : Peak current of the chip
			    0x00 = 1.6A
			    0x20 = 2.3A
			    0x40 = 3.0A
			    0x60 = 3.6A

- in-supply              : Regulator for in vcc supply
- sw-supply              : Regulator for sw supply. This is switched
			   on when LED is in FLASH or TORCH mode.

LED subnode for each LED
Required properties:
- reg			: LED number

Optional properties:
- max-flash-microamp	:  Maximum current in flash mode
- max-torch-microamp    :  Maximum current in torch mode

The device must be referenced by a v4l2 host driver. The reference
should be done with the led node

Example:

host1x {
	vi {
		status = "okay";
		port@0 {
			csi_ab_ep: endpoint@0 {
				remote-endpoint = <&camera0>, <&lm3560_flash0_ep>, <&lm3560_flash1_ep>;
			};
[...]


i2c@7000c500 {
	lm3560: lm3560@53 {
		compatible = "ti,lm3560";
		reg = <0x53>;
		peak-current = <0x00>;
		in-supply = <&vdd_3v3_led>;
		sw-supply = <&vdd_3v9_led>;

		#address-cells = <1>;
		#size-cells = <0>;

		led@0 {
			reg = <0>;
			max-flash-microamp = <700000>;
			port {
				lm3560_flash0_ep: endpoint {
					remote-endpoint = <&csi_ab_ep>;
				};
			};
		};

		led@1 {
			reg = <1>;
			max-flash-microamp = <700000>;
			port {
				lm3560_flash1_ep: endpoint {
					remote-endpoint = <&csi_ab_ep>;
				};
			};
		};
	};
[...]
```

## Documentation/devicetree/bindings/media/sony-imx290.txt
```
Sony IMX290LLR and IMX290LQR CMOS sensor
----------------------------------------

Required properties:

- compatible		: "sony,imx290llr", "sony,imx290lqr" or
			  "sony,imx290";
- reg			: I2C slave address of the sensor;
- xclr-gpio		: GPIO pin for sensor reset;
- dvdd-supply		: digital power supply (1.2V);
- ovdd-supply		: I/O power supply (1.8V);
- avdd-supply		: analog power supply (2.9V);

Optional properties:

- inck-name		: Name of the output master clock. If ommitted no
			  clock is sent and an external clock is assumed;
- xvs-output-len	: Length of the XVS output signal. Acceptible
			  values are 0, 1, 2, 4, 8. 0 is default and
			  means no XVS output;
- inck-max-startup-time-us : Min time to wait for inck to stabilize

The device node should contain one 'port' child node with one child 'endpoint'
node, according to the bindings defined in Documentation/devicetree/bindings/
media/video-interfaces.txt. The following are properties specific to those
nodes.

endpoint node
-------------

- data-lanes	: specifies MIPI CSI-2 data lanes as covered in
		  video-interfaces.txt.
		  The device supports only 2 or 4 data lanes.

Example:

camera@1a {
	compatible = "sony,imx290llr";
	reg = <0x1a>;

	inck-name = "mclk";
	xvs-output-len = <8>;
	xclr-gpio = <&gpio TEGRA_GPIO(BB, 3) GPIO_ACTIVE_LOW>;

	dvdd-supply = <&dvdd_1v2_cam>;
	ovdd-supply = <&ovdd_1v8_cam>;
	avdd-supply = <&avdd_2v9_cam>;

	port {
		imx290llr_1: endpoint {
			remote-endpoint = <&csi_ab_ep>;
			clock-lanes = <0>;
			data-lanes = <0 1 2 3>;
		};
	};
};
```

## Documentation/devicetree/bindings/mfd/sx8634.txt
```
Semtech SX8634 Capacitive Button and Slider Touch Controller

The SX8634 controller is configured with the following properties:

Required parent device properties:
  - compatible: "semtech,sx8634"
  - reg: I2C bus address of the device
  - interrupts: interrupt number of the device

Optional parent device properties:
  - gpios: should specify the GPIO used for reset

The SX8634 provides the following sub devices:

Device			 Supply Names	 Description
------			 ------------	 -----------
sx8634-touch		:		: Touch controller

Example:

	keypad: sx8634@2b {
		compatible = "semtech,sx8634";
		reg = <0x2b>;
		interrupts = <386>;

		touch {
			compatible = "semtech,sx8634-touch";
			#address-cells = <1>;
			#size-cells = <0>;

			threshold = <0xa0>;
			sensitivity = <7>;

			cap@1 {
				reg = <1>;
				label = "Up";
				linux,code = <103>; /* KEY_UP */
			};

			cap@2 {
				reg = <2>;
				label = "Down";
				linux,code = <108>; /* KEY_DOWN */
			};
		};
	};
```

## arch/arm/configs/medcom-wide_defconfig
```kconfig
CONFIG_EXPERIMENTAL=y
CONFIG_LOCALVERSION="-medcom-wide-r16-3"
# CONFIG_LOCALVERSION_AUTO is not set
CONFIG_DEFAULT_HOSTNAME="medcom-wide-xxxxx"
CONFIG_SYSVIPC=y
CONFIG_IKCONFIG=y
CONFIG_IKCONFIG_PROC=y
CONFIG_CGROUP_DEBUG=y
CONFIG_CGROUP_FREEZER=y
CONFIG_CGROUP_CPUACCT=y
CONFIG_RESOURCE_COUNTERS=y
CONFIG_RT_GROUP_SCHED=y
CONFIG_SCHED_AUTOGROUP=y
CONFIG_BLK_DEV_INITRD=y
CONFIG_CC_OPTIMIZE_FOR_SIZE=y
# CONFIG_SYSCTL_SYSCALL is not set
CONFIG_KALLSYMS_ALL=y
CONFIG_EMBEDDED=y
CONFIG_PERF_EVENTS=y
# CONFIG_PCI_QUIRKS is not set
CONFIG_SLAB=y
CONFIG_MODULES=y
CONFIG_MODULE_UNLOAD=y
CONFIG_MODULE_FORCE_UNLOAD=y
CONFIG_DEFAULT_DEADLINE=y
CONFIG_ARCH_TEGRA=y
CONFIG_TAMONTEN=y
CONFIG_MACH_MEDCOM_WIDE=y
CONFIG_TEGRA_PWM=y
CONFIG_TEGRA_EMC_SCALING_ENABLE=y
CONFIG_TEGRA_CLOCK_DEBUG_WRITE=y
CONFIG_USB_HOTPLUG=y
CONFIG_TEGRA_PREINIT_CLOCKS=y
CONFIG_TEGRA_DC_USE_HW_BPP=y
CONFIG_ARM_ERRATA_720789=y
CONFIG_ARM_ERRATA_751472=y
CONFIG_NO_HZ=y
CONFIG_HIGH_RES_TIMERS=y
CONFIG_SMP=y
CONFIG_NR_CPUS=2
CONFIG_PREEMPT=y
CONFIG_AEABI=y
# CONFIG_OABI_COMPAT is not set
CONFIG_HIGHMEM=y
CONFIG_COMPACTION=y
CONFIG_KSM=y
CONFIG_USE_OF=y
CONFIG_ZBOOT_ROM_TEXT=0x0
CONFIG_ZBOOT_ROM_BSS=0x0
CONFIG_ARM_APPENDED_DTB=y
CONFIG_ARM_ATAG_DTB_COMPAT=y
CONFIG_CMDLINE="mem=512M@0M console=ttyS0,115200 root=LABEL=boot:/rootfs.img ro"
CONFIG_CMDLINE_FORCE=y
CONFIG_CPU_FREQ=y
CONFIG_CPU_FREQ_GOV_POWERSAVE=y
CONFIG_CPU_FREQ_GOV_ONDEMAND=y
CONFIG_CPU_FREQ_GOV_CONSERVATIVE=y
CONFIG_CPU_IDLE=y
CONFIG_VFP=y
CONFIG_PM_RUNTIME=y
CONFIG_SUSPEND_TIME=y
CONFIG_NET=y
CONFIG_PACKET=y
CONFIG_UNIX=y
CONFIG_NET_KEY=y
CONFIG_INET=y
CONFIG_IP_MULTICAST=y
CONFIG_IP_ADVANCED_ROUTER=y
CONFIG_IP_PNP=y
CONFIG_IP_PNP_DHCP=y
CONFIG_IP_MROUTE=y
CONFIG_IP_MROUTE_MULTIPLE_TABLES=y
CONFIG_IP_PIMSM_V1=y
CONFIG_IP_PIMSM_V2=y
# CONFIG_INET_XFRM_MODE_TRANSPORT is not set
# CONFIG_INET_XFRM_MODE_TUNNEL is not set
# CONFIG_INET_XFRM_MODE_BEET is not set
CONFIG_TCP_CONG_ADVANCED=y
CONFIG_TCP_CONG_CUBIC=m
CONFIG_TCP_CONG_VEGAS=m
CONFIG_TCP_CONG_VENO=m
CONFIG_TCP_CONG_ILLINOIS=m
CONFIG_IPV6=y
CONFIG_IPV6_PRIVACY=y
CONFIG_IPV6_ROUTER_PREF=y
CONFIG_IPV6_OPTIMISTIC_DAD=y
CONFIG_INET6_AH=m
CONFIG_INET6_ESP=m
CONFIG_INET6_IPCOMP=m
CONFIG_IPV6_MIP6=m
CONFIG_INET6_XFRM_MODE_TRANSPORT=m
CONFIG_INET6_XFRM_MODE_TUNNEL=m
CONFIG_INET6_XFRM_MODE_BEET=m
CONFIG_IPV6_SIT=m
CONFIG_IPV6_TUNNEL=m
CONFIG_IPV6_MULTIPLE_TABLES=y
CONFIG_IPV6_SUBTREES=y
# CONFIG_ANDROID_PARANOID_NETWORK is not set
# CONFIG_NET_ACTIVITY_STATS is not set
CONFIG_NETWORK_PHY_TIMESTAMPING=y
CONFIG_NETFILTER=y
CONFIG_NF_CONNTRACK=m
CONFIG_NF_CONNTRACK_EVENTS=y
CONFIG_NF_CONNTRACK_TIMESTAMP=y
CONFIG_NF_CONNTRACK_SIP=m
CONFIG_NETFILTER_XT_TARGET_CLASSIFY=m
CONFIG_NETFILTER_XT_TARGET_CONNMARK=m
CONFIG_NETFILTER_XT_TARGET_MARK=m
CONFIG_NETFILTER_XT_TARGET_NFLOG=m
CONFIG_NETFILTER_XT_TARGET_NFQUEUE=m
CONFIG_NETFILTER_XT_MATCH_ADDRTYPE=m
CONFIG_NETFILTER_XT_MATCH_CONNBYTES=m
CONFIG_NETFILTER_XT_MATCH_CONNLIMIT=m
CONFIG_NETFILTER_XT_MATCH_CONNMARK=m
CONFIG_NETFILTER_XT_MATCH_CONNTRACK=m
CONFIG_NETFILTER_XT_MATCH_DSCP=m
CONFIG_NETFILTER_XT_MATCH_HELPER=m
CONFIG_NETFILTER_XT_MATCH_HL=m
CONFIG_NETFILTER_XT_MATCH_IPRANGE=m
CONFIG_NETFILTER_XT_MATCH_LIMIT=m
CONFIG_NETFILTER_XT_MATCH_MAC=m
CONFIG_NETFILTER_XT_MATCH_MARK=m
CONFIG_NETFILTER_XT_MATCH_OWNER=m
CONFIG_NETFILTER_XT_MATCH_PHYSDEV=m
CONFIG_NETFILTER_XT_MATCH_PKTTYPE=m
CONFIG_NETFILTER_XT_MATCH_REALM=m
CONFIG_NETFILTER_XT_MATCH_STATE=m
CONFIG_NETFILTER_XT_MATCH_STATISTIC=m
CONFIG_NETFILTER_XT_MATCH_STRING=m
CONFIG_NETFILTER_XT_MATCH_TCPMSS=m
CONFIG_NETFILTER_XT_MATCH_TIME=m
CONFIG_NETFILTER_XT_MATCH_U32=m
CONFIG_IP_SET=m
CONFIG_BRIDGE_NF_EBTABLES=m
CONFIG_BRIDGE_EBT_BROUTE=m
CONFIG_BRIDGE_EBT_T_FILTER=m
CONFIG_BRIDGE_EBT_T_NAT=m
CONFIG_BRIDGE_EBT_802_3=m
CONFIG_BRIDGE_EBT_ARP=m
CONFIG_BRIDGE_EBT_IP=m
CONFIG_BRIDGE_EBT_LIMIT=m
CONFIG_BRIDGE_EBT_MARK=m
CONFIG_BRIDGE_EBT_PKTTYPE=m
CONFIG_BRIDGE_EBT_STP=m
CONFIG_BRIDGE_EBT_VLAN=m
CONFIG_BRIDGE_EBT_ARPREPLY=m
CONFIG_BRIDGE_EBT_DNAT=m
CONFIG_BRIDGE_EBT_MARK_T=m
CONFIG_BRIDGE_EBT_REDIRECT=m
CONFIG_BRIDGE_EBT_SNAT=m
CONFIG_BRIDGE_EBT_LOG=m
CONFIG_BRIDGE_EBT_NFLOG=m
CONFIG_BRIDGE=y
CONFIG_VLAN_8021Q=y
# CONFIG_RPS is not set
# CONFIG_WIRELESS is not set
CONFIG_DEVTMPFS=y
# CONFIG_FIRMWARE_IN_KERNEL is not set
CONFIG_MTD=y
CONFIG_MTD_CMDLINE_PARTS=y
CONFIG_MTD_AFS_PARTS=m
CONFIG_MTD_CHAR=y
CONFIG_MTD_BLOCK=y
CONFIG_MTD_CFI=y
CONFIG_MTD_NAND_TEGRA=y
CONFIG_MTD_MTDRAM=m
CONFIG_MTD_NAND=y
CONFIG_MTD_NAND_VERIFY_WRITE=y
CONFIG_MTD_NAND_PLATFORM=y
CONFIG_MTD_UBI=y
CONFIG_MTD_UBI_GLUEBI=m
CONFIG_BLK_DEV_LOOP=y
CONFIG_BLK_DEV_RAM=m
CONFIG_MISC_DEVICES=y
CONFIG_UID_STAT=y
CONFIG_TEGRA_CRYPTO_DEV=y
CONFIG_MPU_SENSORS_TIMERIRQ=y
# CONFIG_INV_SENSORS is not set
CONFIG_SCSI=y
CONFIG_BLK_DEV_SD=y
CONFIG_BLK_DEV_SR=y
CONFIG_BLK_DEV_SR_VENDOR=y
CONFIG_CHR_DEV_SG=y
CONFIG_SCSI_MULTI_LUN=y
CONFIG_NETDEVICES=y
# CONFIG_NETDEV_1000 is not set
# CONFIG_NETDEV_10000 is not set
# CONFIG_WLAN is not set
CONFIG_USB_USBNET=y
# CONFIG_USB_NET_AX8817X is not set
# CONFIG_USB_NET_CDCETHER is not set
# CONFIG_USB_NET_CDC_NCM is not set
CONFIG_USB_NET_SMSC95XX=y
# CONFIG_USB_NET_NET1080 is not set
# CONFIG_USB_NET_CDC_SUBSET is not set
# CONFIG_USB_NET_ZAURUS is not set
# CONFIG_INPUT_MOUSEDEV is not set
CONFIG_INPUT_EVDEV=y
# CONFIG_INPUT_KEYBOARD is not set
# CONFIG_INPUT_MOUSE is not set
CONFIG_INPUT_TOUCHSCREEN=y
CONFIG_TOUCHSCREEN_USB_COMPOSITE=m
CONFIG_INPUT_MISC=y
CONFIG_INPUT_UINPUT=m
CONFIG_INPUT_SX8634=y
# CONFIG_SERIO is not set
# CONFIG_LEGACY_PTYS is not set
# CONFIG_DEVKMEM is not set
CONFIG_SERIAL_8250=y
CONFIG_SERIAL_8250_CONSOLE=y
# CONFIG_HW_RANDOM is not set
CONFIG_I2C_CHARDEV=y
CONFIG_I2C_MUX=m
CONFIG_I2C_MUX_GPIO=m
CONFIG_I2C_SLAVE=y
CONFIG_I2C_OCORES=y
CONFIG_I2C_SLAVE_TEGRA=y
CONFIG_GPIO_SYSFS=y
CONFIG_GPIO_GENERIC_PLATFORM=y
CONFIG_THERMAL=y
CONFIG_WATCHDOG=y
CONFIG_WATCHDOG_CORE=y
CONFIG_SOFT_WATCHDOG=m
CONFIG_TEGRA_WATCHDOG=m
CONFIG_MFD_SX8634=y
CONFIG_REGULATOR=y
CONFIG_REGULATOR_FIXED_VOLTAGE=y
CONFIG_REGULATOR_VIRTUAL_CONSUMER=y
CONFIG_MEDIA_SUPPORT=y
CONFIG_VIDEO_DEV=y
CONFIG_DVB_CORE=m
# CONFIG_DVB_NET is not set
# CONFIG_RC_CORE is not set
# CONFIG_MEDIA_TUNER_CUSTOMISE is not set
# CONFIG_TEGRA_CAMERA is not set
# CONFIG_TEGRA_DTV is not set
# CONFIG_V4L_USB_DRIVERS is not set
# CONFIG_RADIO_ADAPTERS is not set
CONFIG_DVB_USB_V2=m
CONFIG_DVB_USB_AD1456=m
# CONFIG_DVB_FE_CUSTOMISE is not set
# CONFIG_VGA_ARB is not set
CONFIG_VIDEO_OUTPUT_CONTROL=y
CONFIG_FB=y
CONFIG_BACKLIGHT_LCD_SUPPORT=y
CONFIG_LCD_CLASS_DEVICE=y
CONFIG_BACKLIGHT_CLASS_DEVICE=y
# CONFIG_BACKLIGHT_GENERIC is not set
CONFIG_BACKLIGHT_PWM=y
CONFIG_BACKLIGHT_TEGRA_PWM=y
CONFIG_BACKLIGHT_SX8634=y
CONFIG_FRAMEBUFFER_CONSOLE=y
CONFIG_FRAMEBUFFER_CONSOLE_DETECT_PRIMARY=y
CONFIG_FRAMEBUFFER_CONSOLE_ROTATION=y
CONFIG_LOGO=y
# CONFIG_LOGO_LINUX_MONO is not set
# CONFIG_LOGO_LINUX_CLUT224 is not set
CONFIG_SOUND=y
CONFIG_SND=y
CONFIG_SND_ALOOP=m
# CONFIG_SND_PCI is not set
# CONFIG_SND_ARM is not set
CONFIG_SND_USB_AUDIO=m
CONFIG_SND_SOC=y
CONFIG_SND_SOC_TEGRA=y
CONFIG_HIDRAW=y
CONFIG_HID_MULTITOUCH=y
CONFIG_USB=y
CONFIG_USB_ANNOUNCE_NEW_DEVICES=y
CONFIG_USB_DEVICEFS=y
CONFIG_USB_SUSPEND=y
CONFIG_USB_OTG=y
# CONFIG_USB_OTG_WHITELIST is not set
CONFIG_USB_MON=m
CONFIG_USB_EHCI_HCD=y
CONFIG_USB_EHCI_TEGRA=y
CONFIG_USB_EHCI_ONOFF_FEATURE=y
CONFIG_USB_STORAGE=y
CONFIG_USB_LIBUSUAL=y
CONFIG_USB_GADGET=y
CONFIG_USB_GADGET_VBUS_DRAW=500
CONFIG_USB_TEGRA=y
CONFIG_USB_MASS_STORAGE=m
CONFIG_USB_TEGRA_OTG=y
CONFIG_MMC=y
CONFIG_MMC_UNSAFE_RESUME=y
CONFIG_MMC_SDHCI=y
CONFIG_MMC_SDHCI_PLTFM=y
CONFIG_MMC_SDHCI_TEGRA=y
CONFIG_STAGING=y
CONFIG_USBIP_CORE=m
CONFIG_USBIP_VHCI_HCD=m
CONFIG_USBIP_HOST=m
CONFIG_ZSMALLOC=y
CONFIG_ZRAM=m
CONFIG_ALTERA_STAPL=m
CONFIG_EXT4_FS=y
CONFIG_EXT4_FS_POSIX_ACL=y
CONFIG_EXT4_FS_SECURITY=y
CONFIG_FANOTIFY=y
CONFIG_AUTOFS4_FS=m
CONFIG_FUSE_FS=y
CONFIG_MSDOS_FS=m
CONFIG_VFAT_FS=y
CONFIG_NTFS_FS=m
CONFIG_NTFS_RW=y
CONFIG_TMPFS=y
CONFIG_UBIFS_FS=y
CONFIG_UBIFS_FS_XATTR=y
CONFIG_UBIFS_FS_ADVANCED_COMPR=y
CONFIG_SQUASHFS=y
CONFIG_SQUASHFS_XATTR=y
CONFIG_SQUASHFS_XZ=y
CONFIG_NFS_FS=y
CONFIG_NFS_V4=y
CONFIG_NFS_V4_1=y
CONFIG_ROOT_NFS=y
CONFIG_CIFS=m
CONFIG_PARTITION_ADVANCED=y
CONFIG_EFI_PARTITION=y
CONFIG_NLS_CODEPAGE_437=y
CONFIG_NLS_ASCII=m
CONFIG_NLS_ISO8859_1=y
CONFIG_NLS_UTF8=m
CONFIG_PRINTK_TIME=y
CONFIG_LOCKUP_DETECTOR=y
CONFIG_BOOTPARAM_HARDLOCKUP_PANIC=y
CONFIG_BOOTPARAM_SOFTLOCKUP_PANIC=y
CONFIG_DEFAULT_HUNG_TASK_TIMEOUT=300
CONFIG_BOOTPARAM_HUNG_TASK_PANIC=y
CONFIG_SCHEDSTATS=y
CONFIG_TIMER_STATS=y
CONFIG_DEBUG_SLAB=y
# CONFIG_DEBUG_PREEMPT is not set
CONFIG_DEBUG_MUTEXES=y
CONFIG_DEBUG_INFO=y
CONFIG_FUNCTION_TRACER=y
CONFIG_KGDB=y
CONFIG_DEBUG_USER=y
CONFIG_CRYPTO_AUTHENC=y
CONFIG_CRYPTO_TEST=m
CONFIG_CRYPTO_CBC=y
CONFIG_CRYPTO_ECB=y
CONFIG_CRYPTO_HMAC=y
CONFIG_CRYPTO_MD5=y
CONFIG_CRYPTO_SHA1=y
CONFIG_CRYPTO_SHA256=y
CONFIG_CRYPTO_ARC4=y
CONFIG_CRYPTO_DES=y
CONFIG_CRYPTO_TWOFISH=y
# CONFIG_CRYPTO_ANSI_CPRNG is not set
CONFIG_CRYPTO_DEV_TEGRA_AES=y
CONFIG_CRC_CCITT=y
CONFIG_LIBCRC32C=y
CONFIG_EGALAX_HACK=y
```
